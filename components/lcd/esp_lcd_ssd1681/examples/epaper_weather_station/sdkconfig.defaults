## components/lcd/esp_lcd_ssd1681/examples/epaper_weather_station/sdkconfig.defaults
```kconfig
CONFIG_LV_CONF_SKIP=y
CONFIG_LV_USE_CLIB_MALLOC=y
CONFIG_LV_USE_CLIB_SPRINTF=y
CONFIG_LV_USE_CLIB_STRING=y
CONFIG_LV_COLOR_DEPTH_16=y
CONFIG_LV_FONT_MONTSERRAT_14=y
CONFIG_LV_FONT_MONTSERRAT_28=y
CONFIG_LV_FONT_MONTSERRAT_40=y
CONFIG_LV_FONT_DEFAULT_MONTSERRAT_14=y
CONFIG_LV_USE_THEME_DEFAULT=n
CONFIG_LV_USE_THEME_MONO=y
CONFIG_LV_USE_LOG=n
CONFIG_LV_USE_SYSMON=n
CONFIG_LV_USE_PERF_MONITOR=n
CONFIG_LV_USE_MEM_MONITOR=n
CONFIG_FREERTOS_HZ=1000
# LVGL layout + I1 render + SSD1681 plane conversion all run on app_main.
CONFIG_ESP_MAIN_TASK_STACK_SIZE=16384
```
